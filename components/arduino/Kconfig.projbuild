## sdkconfig.defaults.fruitjam_c6
```kconfig
# BT_LE_HCI
CONFIG_BT_LE_HCI_INTERFACE_USE_UART=y
CONFIG_BT_LE_HCI_UART_FLOWCTRL=y
CONFIG_BT_LE_HCI_UART_TX_PIN=16
CONFIG_BT_LE_HCI_UART_RX_PIN=17
CONFIG_BT_LE_HCI_UART_RTS_PIN=18
CONFIG_BT_LE_HCI_UART_CTS_PIN=9
CONFIG_BT_LE_HCI_UART_BAUD=115200
CONFIG_BT_LE_CONTROLLER_LOG_ENABLED=y
```
